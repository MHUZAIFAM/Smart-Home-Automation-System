#include "BluetoothSerial.h"
#include <Wire.h>
#include "DHT.h"
#include <Adafruit_SSD1306.h>
#include <Adafruit_GFX.h>
#include <Ticker.h>
#include "soc/soc.h"
#include "soc/rtc_cntl_reg.h"

#if !defined(CONFIG_BT_ENABLED) || !defined(CONFIG_BLUEDROID_ENABLED)
#error Bluetooth is not enabled! Please run `make menuconfig` to and enable it
#endif

#if !defined(CONFIG_BT_SPP_ENABLED)
#error Serial Bluetooth not available or not enabled. It is only available for the ESP32 chip.
#endif

/* Using core 1 of ESP32 */
#if CONFIG_FREERTOS_UNICORE
static const BaseType_t app_cpu = 0;
#else
static const BaseType_t app_cpu = 1;
#endif

/* Sensor pins */
#define DHTPIN 33                 // DHT11 temperature sensor
#define DHTTYPE DHT11
#define lightSensor 26            // LDR sensor
#define echo 2                    // Ultrasonic sensor echo pin
#define trigger 15                // Ultrasonic sensor trigger pin

/* Relay pins */
#define fanRelay 17               // Relay for fan TX2
#define lightRelay 16             // Relay for light RX2

/* Led pins */
#define ultrasonicLed 18          // LED for ultrasonic alert
#define dhtled 19

/* OLED Display Parameters */
#define SCREEN_WIDTH 128          // OLED display width
#define SCREEN_HEIGHT 64          // OLED display height
#define SCREEN_ADDRESS 0x3C       // I2C address for OLED display
#define OLED_RESET 4 

/* Objects */
DHT dht(DHTPIN, DHTTYPE);
Adafruit_SSD1306 display(SCREEN_WIDTH, SCREEN_HEIGHT, &Wire, OLED_RESET);
BluetoothSerial SerialBT;
Ticker ultrasonic;

/* Queues */
static QueueHandle_t tempReading;
static QueueHandle_t lightReading;

/* Task handles */
TaskHandle_t autoFan_handle = NULL;
TaskHandle_t autoLight_handle = NULL;

/* Status indicators */
bool fanStatus = false;
bool lightStatus = false;
bool ultrasonicStatus = false;

/* Setup */
void setup() {
  WRITE_PERI_REG(RTC_CNTL_BROWN_OUT_REG, 0);
  
  Serial.begin(115200);
  Wire.begin();
  SerialBT.begin("ESP32");
  dht.begin();
  ultrasonic.attach(1, ultrasonicDetect);
  display.begin(SSD1306_SWITCHCAPVCC, SCREEN_ADDRESS);

  /* Pin Modes */
  pinMode(fanRelay, OUTPUT);
  pinMode(lightRelay, OUTPUT);
  pinMode(ultrasonicLed, OUTPUT);
  pinMode(dhtled, OUTPUT);
  pinMode(trigger, OUTPUT);
  pinMode(echo, INPUT);

  /* Relays off at start */
  digitalWrite(fanRelay, HIGH);
  digitalWrite(lightRelay, HIGH);

  /* LED off at start */
  digitalWrite(ultrasonicLed, LOW);
  digitalWrite(dhtled, LOW);

  /* Display startup */
  introDisplay();

  /* Queues */
  tempReading = xQueueCreate(10, sizeof(int));
  lightReading = xQueueCreate(10, sizeof(int));

  /* Tasks */
  xTaskCreatePinnedToCore(tempRead, "Temp read", 2048, NULL, 1, NULL, app_cpu);
  xTaskCreatePinnedToCore(autoFan, "Auto fan", 2048, NULL, 1, &autoFan_handle, app_cpu);
  xTaskCreatePinnedToCore(lightRead, "Light read", 1024, NULL, 1, NULL, app_cpu);
  xTaskCreatePinnedToCore(autoLight, "Auto light", 1024, NULL, 1, &autoLight_handle, app_cpu);
  xTaskCreatePinnedToCore(switchControl, "Switch control", 4096, NULL, 1, NULL, app_cpu);
  xTaskCreatePinnedToCore(indicatorDisplay, "OLED display", 8192, NULL, 1, NULL, app_cpu);

  /* Suspend auto tasks initially */
  vTaskSuspend(autoFan_handle);
  vTaskSuspend(autoLight_handle);
}

void loop() {
  vTaskDelay(500 / portTICK_PERIOD_MS);
}

/* Tasks */

/* Task: Temperature sensing */
void tempRead(void *parameter) {
  int t = 0;
  while (true) {
    t = dht.readTemperature();
    if (isnan(t)) {
      Serial.println(F("Failed to read from DHT sensor!"));
      return;
    }
    SerialBT.print("#");
    SerialBT.print(t);
    SerialBT.print("?");
    Serial.print("Temperature: ");
    Serial.println(t);
    xQueueSend(tempReading, &t, 10);
    vTaskDelay(2000 / portTICK_PERIOD_MS);
  }
}

/* Task: Auto Fan Control */
void autoFan(void *parameter) {
  int tempValue;
  while (true) { 
    xQueueReceive(tempReading, &tempValue, portMAX_DELAY);
    if (tempValue > 21) {
     // digitalWrite(dhtled, HIGH);
      SerialBT.print("Fan on?");
      digitalWrite(fanRelay, LOW);
      fanStatus = true;
    } else {
      //digitalWrite(dhtled, LOW);
      SerialBT.print("Fan off?");
      digitalWrite(fanRelay, HIGH);
      fanStatus = false;
    }
    vTaskDelay(200 / portTICK_PERIOD_MS);
  }
}

/* Task: Light Sensing */
void lightRead(void *parameter) {
  int lightValue;
  while (true) {
    lightValue = analogRead(lightSensor);
    Serial.print("Light intensity: ");
    Serial.println(lightValue);
    xQueueSend(lightReading, &lightValue, 10);
    vTaskDelay(2000 / portTICK_PERIOD_MS);
  }
}

/* Task: Auto Light Control */
void autoLight(void *parameter) {
  int lightValue;
  while (true) {
    xQueueReceive(lightReading, &lightValue, portMAX_DELAY);
    if (lightValue >= 1500) {
      SerialBT.print("Bulb on?");
      digitalWrite(lightRelay, LOW);
      lightStatus = true;
    } else {
      SerialBT.print("Bulb off?");
      digitalWrite(lightRelay, HIGH);
      lightStatus = false;
    }
    vTaskDelay(200 / portTICK_PERIOD_MS);
  }
}

/* Task: Ultrasonic Distance Detection */
/* Task for finding distance using Ultrasonic sensor */
void ultrasonicDetect() { 
  int distance;
  int duration;

  digitalWrite(trigger, LOW);
  delayMicroseconds(2);
  digitalWrite(trigger, HIGH);
  delayMicroseconds(10);
  digitalWrite(trigger, LOW);

  duration = pulseIn(echo, HIGH);
  distance = (duration / 2) * 0.0343;

  Serial.print("Distance: ");
  Serial.println(distance);

  if (distance > 20) {
    SerialBT.print("Ultrasonic inactive?");
    digitalWrite(ultrasonicLed, LOW);
    ultrasonicStatus = false;
  }
  else if (distance <= 20) {
    SerialBT.print("Ultrasonic active?");
    digitalWrite(ultrasonicLed, HIGH);
    ultrasonicStatus = true;
  }
}

/* Task: Bluetooth Manual Control */
void switchControl(void *parameter) {
  char input;
  while (true) {
    if (SerialBT.available() > 0) {
      input = SerialBT.read();
      switch (input) {
        case 'M': vTaskSuspend(autoFan_handle); vTaskSuspend(autoLight_handle); break;
        case 'F': SerialBT.print("Fan on?"); digitalWrite(fanRelay, LOW); fanStatus = true; break;
        case 'Y': SerialBT.print("Fan off?"); digitalWrite(fanRelay, HIGH); fanStatus = false; break;
        case 'L': SerialBT.print("Bulb on?"); digitalWrite(lightRelay, LOW); lightStatus = true; break;
        case 'Z': SerialBT.print("Bulb off?"); digitalWrite(lightRelay, HIGH); lightStatus = false; break;
        case 'A': vTaskResume(autoFan_handle); vTaskResume(autoLight_handle); break;
        case 'O': vTaskSuspend(autoFan_handle); vTaskSuspend(autoLight_handle);
          digitalWrite(fanRelay, HIGH); digitalWrite(lightRelay, HIGH); fanStatus = false; lightStatus = false; break;
      }
    }
  }
}

/* Task: OLED Display */
/* Task: OLED Display */
void indicatorDisplay(void *parameter) {
  int tempValue = 0;
  int distance = 0;
  int lightValue = 0;

  while (true) {
    display.clearDisplay();
    display.setTextSize(1);
    display.setTextColor(SSD1306_WHITE);
    display.setCursor(0, 0);

    // Display Fan status
    display.print("Fan: ");
    display.println(fanStatus ? "ON" : "OFF");

    // Display Light status
    display.print("Light: ");
    display.println(lightStatus ? "ON" : "OFF");

    // Read and display Temperature
    if (xQueueReceive(tempReading, &tempValue, 0)) {
      display.print("Temp: ");
      display.print(tempValue);
      display.println("C");
    } 

    // Read and display Distance
    if (ultrasonicStatus) {
      distance = (pulseIn(echo, HIGH) / 2) * 0.0343; // Calculate distance from ultrasonic sensor
      display.print("Dist: ");
      display.print(distance);
      display.println(" cm");
    } 
    else{
      display.print("Dist: ");
      display.print(distance);
      //display.println("N/A");
    }

    // Read and display Light Intensity
    if (xQueueReceive(lightReading, &lightValue, 0)) {
      display.print("Light: ");
      display.print(lightValue);
      display.println(" LDR");
    } 

    // Update OLED screen with new values
    display.display();
    
    // Delay to update the display every 1 second
    vTaskDelay(1000 / portTICK_PERIOD_MS);
  }
}

void introDisplay() {
  display.clearDisplay();
  
  const unsigned char intro [] PROGMEM = {
    0x00, 0x00, 0x00, 0x00, 0x1f, 0xff, 0xff, 0xff, 0xff, 0xff, 0xff, 0xf8, 0x00, 0x00, 0x00, 0x00, 
    0x00, 0x00, 0x00, 0x00, 0x7f, 0xff, 0xff, 0xff, 0xff, 0xff, 0xff, 0xfe, 0x00, 0x00, 0x00, 0x00, 
    0x00, 0x00, 0x00, 0x00, 0x7b, 0x80, 0x00, 0x00, 0x00, 0x00, 0x01, 0xde, 0x00, 0x00, 0x00, 0x00, 
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    0x00, 0x00, 0x00, 0x00, 0x00, 0x00, 0x00, 0x3f, 0xff, 0xfe, 0x00, 0x00, 0x00, 0x00, 0x00, 0x00
  };
  
  display.drawBitmap(0, 0, intro, 128, 64, WHITE);
  
  display.display();
  delay(4000);
  display.clearDisplay();

  display.setTextColor(WHITE);                                // Set the color
  display.setTextSize(2);                                     // Set the font size
  display.setCursor(6,10);                                    // Set the cursor coordinates
  display.print("Smart Home");
  display.setCursor(6,40);
  display.print("Automation");

  display.display();
  delay(4000);
  display.clearDisplay();

 // Embedded Systems Design
   display.setTextColor(WHITE);                                // Set the color
  display.setTextSize(2);                                     // Set the font size
  display.setCursor(6,10);                                    // Set the cursor coordinates
  display.print("EE-423 ESD");
  display.display();
  delay(2000);
  display.clearDisplay();

// Group names
//Muhammad Huzaifa
  display.setTextColor(WHITE);                                // Set the color
  display.setTextSize(2);                                     // Set the font size
  display.setCursor(6,10);                                    // Set the cursor coordinates
  display.print("M Huzaifa");
  display.display();
  delay(2000);
  display.clearDisplay();
 //Wajiha Ali
  display.setTextColor(WHITE);                                // Set the color
  display.setTextSize(2);                                     // Set the font size
  display.setCursor(6,10);                                    // Set the cursor coordinates
  display.print("Wajiha Ali");
  display.display();
  delay(2000);
  display.clearDisplay();
  
  //Abdul Hadi
  //Muhammad Huzaifa
  display.setTextColor(WHITE);                                // Set the color
  display.setTextSize(2);                                     // Set the font size
  display.setCursor(6,10);                                    // Set the cursor coordinates
  display.print("Abdul Hadi");
  display.display();
  delay(2000);
  display.clearDisplay();
}
